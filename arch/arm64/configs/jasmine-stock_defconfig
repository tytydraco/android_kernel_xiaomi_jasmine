## drivers/input/fingerprint/Kconfig
```kconfig
 menu "Fingerprint Drivers"

config FINGERPRINT_GOODIX
	tristate "goodix gf3208 fingerprint drvier support"
	help
	  say y here to enable goodix fingerprint driver support!

config FINGERPRINT_FPC1020
	tristate "fpc1020 fingerprint drvier support"
	help
	  say y here to enable fpc fingerprint driver support!

endmenu
```
